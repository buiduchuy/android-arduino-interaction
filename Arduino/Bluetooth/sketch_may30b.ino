//#include <font.h>
#include <LedControl.h>
#include <avr/pgmspace.h>
//We always have to include the library
#include <SoftwareSerial.h>// import the serial library
#include "string.h"


// Mảng xác định cách hiển thị của các kí tự
const char font7x5[] PROGMEM = {
  0x00, 0x00, 0x00, 0x00, 0x00,
  0x00, 0x00, 0x00, 0x00, 0x00,
  0x00, 0x00, 0x00, 0x00, 0x00,
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  0x08, 0x1C, 0x2A, 0x08, 0x08,
};

/*
 pin 12 is connected to the DataIn
 pin 11 is connected to the CLK
 pin 10 is connected to LOAD
 */
LedControl lc = LedControl(12, 11, 10, 2);
int index = 0;
byte text[512];
byte byteRead;

unsigned long delaytime = 200;

SoftwareSerial Genotronex(0, 1); // RX, TX
byte BluetoothData; // the data given from Computer
String content = "";
//String temp = "";
char character;
int flag = 300;
int temp;

// thiết lập ban đầu của Arduino
void setup() {
  /*
   The MAX72XX is in power-saving mode on startup,
   we have to do a wakeup call
   */
  lc.shutdown(0, false);
  /* Set the brightness to a medium values */
  lc.setIntensity(0, 8);
  /* and clear the display */
  lc.clearDisplay(0);

  lc.shutdown(1, false);
  /* Set the brightness to a medium values */
  lc.setIntensity(1, 8);
  /* and clear the display */
  lc.clearDisplay(1);

  // Turn the Serial Protocol ON
  Serial.begin(9600);
  //Genotronex.begin(9600);
}

// Chương trình xử lý chính
void loop()
{
  if (Serial.available() > 0) {
    content = Serial.readStringUntil('\n');
    Serial.println(content);
  }
  if (content != "")
  {
    for(int i = 0; i<3; i++)
    {
      buffer(content);
      scrollLeft();
    }
  }
  temp = analogRead(A0);
  temp = temp * 0.48825125;
  content = (String)temp;
  Serial.println(content);
  buffer(content);
  scrollLeft();
  content = "";
}

// Map kí tự tách được với hiển thị của nó
void copyChar2Buffer(char ch)
{
  long tchr = ch;
  for (int i = index; i < index + 5; i++)
  {
    text[i] = pgm_read_byte(&font7x5[((tchr) * 5) + i - index]);
  }
  index += 5;
}

// tách chuỗi nhận được thành từng kí tự và map với hiển thị
void buffer(String message)
{
  // Khoảng trắng để chữ chạy từ bên phải
  // 2 tấm led - 16 đèn led
  for (int i = 0; i < 16; i++) text[i] = B00000000;
  index = 16;
  //Copy character hex
  for (int i = 0; i < message.length(); i++)
  {
    copyChar2Buffer(message[i]);
    text[index] = B00000000; // khoảng trắng nhỏ giữa 2 kí tự
    index++;
  }
  //Set end SPACE
  for (int i = index; i < index + 16; i++) text[i] = B00000000;
  index += 16;

}

// chỉ định cách hiển thị và chuyển động của led
// chữ chạy sang trái.
void scrollLeft()
{
  for (int co = 0; co < index - 16; co ++)
  {
    if (Serial.available() > 0)
      break;
    lc.setRow(1, 7, text[co + 7]);
    lc.setRow(1, 6, text[co + 6]);
    lc.setRow(1, 5, text[co + 5]);
    lc.setRow(1, 4, text[co + 4]);
    lc.setRow(1, 3, text[co + 3]);
    lc.setRow(1, 2, text[co + 2]);
    lc.setRow(1, 1, text[co + 1]);
    lc.setRow(1, 0, text[co + 0]);

    lc.setRow(0, 7, text[co + 15]);
    lc.setRow(0, 6, text[co + 14]);
    lc.setRow(0, 5, text[co + 13]);
    lc.setRow(0, 4, text[co + 12]);
    lc.setRow(0, 3, text[co + 11]);
    lc.setRow(0, 2, text[co + 10]);
    lc.setRow(0, 1, text[co + 9]);
    lc.setRow(0, 0, text[co + 8]);
    delay(delaytime);
  }
}



